## sdkconfig.defaults
```kconfig
# mbedTLS 配置优化以减少内存和栈使用
CONFIG_MBEDTLS_SSL_MAX_CONTENT_LEN=256
CONFIG_MBEDTLS_SSL_PROTO_TLS1_2=y
CONFIG_MBEDTLS_SSL_PROTO_TLS1_1=n
CONFIG_MBEDTLS_SSL_PROTO_TLS1=n
CONFIG_MBEDTLS_SSL_PROTO_SSL3=n
CONFIG_MBEDTLS_SSL_PROTO_DTLS=n

# 禁用不必要的特性以节省内存
CONFIG_MBEDTLS_SSL_ALPN=n
CONFIG_MBEDTLS_SSL_SESSION_TICKETS=n
CONFIG_MBEDTLS_SSL_RENEGOTIATION=n
CONFIG_MBEDTLS_SSL_EXTENDED_MASTER_SECRET=n
CONFIG_MBEDTLS_SSL_FALLBACK_SCSV=n

# 禁用不必要的椭圆曲线以节省栈空间
CONFIG_MBEDTLS_ECP_DP_SECP521R1_ENABLED=n
CONFIG_MBEDTLS_ECP_DP_SECP384R1_ENABLED=n
CONFIG_MBEDTLS_ECP_DP_BP512R1_ENABLED=n
CONFIG_MBEDTLS_ECP_DP_BP384R1_ENABLED=n
CONFIG_MBEDTLS_ECP_DP_BP256R1_ENABLED=n
CONFIG_MBEDTLS_ECP_DP_CURVE25519_ENABLED=n
CONFIG_MBEDTLS_ECP_DP_SECP256K1_ENABLED=n
CONFIG_MBEDTLS_ECP_DP_SECP224R1_ENABLED=n
CONFIG_MBEDTLS_ECP_DP_SECP192R1_ENABLED=n

# 只启用一个椭圆曲线以最小化栈使用
CONFIG_MBEDTLS_ECP_DP_SECP256R1_ENABLED=y

# 限制密码套件到最小集合（只使用一个套件以减少栈使用）
CONFIG_MBEDTLS_SSL_CIPHERSUITES="TLS_RSA_WITH_AES_128_GCM_SHA256"

# 禁用不必要的哈希算法以减少栈使用 - 强制禁用SHA512
CONFIG_MBEDTLS_SHA512_C=n
CONFIG_MBEDTLS_SHA384_C=n
CONFIG_MBEDTLS_SHA224_C=n
CONFIG_MBEDTLS_SHA1_C=n

# 减少内部缓冲区大小以节省栈空间
CONFIG_MBEDTLS_SSL_IN_CONTENT_LEN=256
CONFIG_MBEDTLS_SSL_OUT_CONTENT_LEN=256

# 禁用调试功能
CONFIG_MBEDTLS_DEBUG=n
CONFIG_MBEDTLS_TLS_MEMORY_DEBUG=n
CONFIG_MBEDTLS_ERROR_C=n

# 启用硬件加速（如果可用）
CONFIG_MBEDTLS_HARDWARE_AES=y
CONFIG_MBEDTLS_HARDWARE_MPI=y
CONFIG_MBEDTLS_HARDWARE_SHA=y

# 任务栈大小调整
CONFIG_ARDUINO_LOOP_STACK_SIZE=122880

# 其他任务栈大小调整
CONFIG_ESP_TASK_WDT_STACK_SIZE=4096
CONFIG_ESP_SYSTEM_CHECK_STACK_SIZE=4096

# 禁用更多不必要的特性以进一步减少栈使用
CONFIG_MBEDTLS_ECP_C=n
CONFIG_MBEDTLS_ECDH_C=n
CONFIG_MBEDTLS_ECDSA_C=n
CONFIG_MBEDTLS_KEY_EXCHANGE_ECDHE_RSA_ENABLED=n
CONFIG_MBEDTLS_KEY_EXCHANGE_ECDHE_ECDSA_ENABLED=n
CONFIG_MBEDTLS_KEY_EXCHANGE_ECDH_RSA_ENABLED=n
CONFIG_MBEDTLS_KEY_EXCHANGE_ECDH_ECDSA_ENABLED=n

# 禁用更多算法以减少栈使用
CONFIG_MBEDTLS_DES_C=n
CONFIG_MBEDTLS_CAMELLIA_C=n
CONFIG_MBEDTLS_BLOWFISH_C=n
CONFIG_MBEDTLS_XTEA_C=n
CONFIG_MBEDTLS_ARC4_C=n

# 只启用必要的哈希算法
CONFIG_MBEDTLS_SHA256_C=y
CONFIG_MBEDTLS_MD5_C=n

# 减少mbedtls内部内存使用
CONFIG_MBEDTLS_INTERNAL_MEM_ALLOC=y
CONFIG_MBEDTLS_DYNAMIC_BUFFER=n
```
